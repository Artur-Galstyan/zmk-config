#include "dactyl_manuform.dtsi"

&kscan0 {
    col-gpios
        = <&gpio0 31 GPIO_ACTIVE_HIGH>   // pin 031 - Column 0 (Q key) ✓
        , <&gpio0 29 GPIO_ACTIVE_HIGH>   // pin 029 - Column 1 (W key) ✓
        , <&gpio0 2 GPIO_ACTIVE_HIGH>    // pin 002 - Column 2 (E key) ✓
        , <&gpio0 10 GPIO_ACTIVE_HIGH>   // pin 010 - Column 3 (R key) ✓
        , <&gpio0 9 GPIO_ACTIVE_HIGH>    // pin 009 - Column 4 (T key) - testing
        ;
};
