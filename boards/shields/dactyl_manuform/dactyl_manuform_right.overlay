#include "dactyl_manuform.dtsi"

&default_transform {
    col-offset = <5>;
};

&kscan0 {
    col-gpios
        = <&gpio0 31 GPIO_ACTIVE_HIGH>   // pin 031 - Column 0 ✓
        , <&gpio0 29 GPIO_ACTIVE_HIGH>   // pin 029 - Column 1 ✓
        , <&gpio0 2 GPIO_ACTIVE_HIGH>    // pin 002 - Column 2 ✓
        , <&gpio0 10 GPIO_ACTIVE_HIGH>   // pin 010 - Column 3 ✓
        , <&gpio0 9 GPIO_ACTIVE_HIGH>    // pin 009 - Column 4 ✓
        ;
};
